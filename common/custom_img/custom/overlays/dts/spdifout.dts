/dts-v1/;
/plugin/;

/ {
    fragment@0 {
        target = <&spdifa>;
        __overlay__ {
			     status = "disabled";
        };
    };
};                                                          
